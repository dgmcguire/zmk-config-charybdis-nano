## boards/shields/charybdis_tb_test/Kconfig.defconfig
```kconfig
# Copyright (c) 2026 The ZMK Contributors
# SPDX-License-Identifier: MIT

if SHIELD_CHARYBDIS_TB_TEST || SHIELD_CHARYBDIS_TB_LP

config ZMK_USB
	default y

endif

if SHIELD_CHARYBDIS_TB_TEST

config ZMK_KEYBOARD_NAME
	default "Charybdis TB"

endif

if SHIELD_CHARYBDIS_TB_LP

config ZMK_KEYBOARD_NAME
	default "Charybdis LP"

config ZMK_SLEEP
	default y

endif
```

## boards/shields/charybdis_tb_test/Kconfig.shield
```kconfig
# Copyright (c) 2026 The ZMK Contributors
# SPDX-License-Identifier: MIT

config SHIELD_CHARYBDIS_TB_TEST
	def_bool $(shields_list_contains,charybdis_tb_test)

config SHIELD_CHARYBDIS_TB_TEST_LP
	def_bool $(shields_list_contains,charybdis_tb_test_lp)
```
